## conf/bblayers.conf.sample
```bitbake
# POKY_BBLAYERS_CONF_VERSION is increased each time build/conf/bblayers.conf
# changes incompatibly
POKY_BBLAYERS_CONF_VERSION = "2"

BBPATH = "${TOPDIR}"
BBFILES ?= ""

BBLAYERS ?= " \
    ${HOME}/poky-honister/meta \
    ${HOME}/poky-honister/meta-poky \
    ${HOME}/poky-honister/meta-openembedded/meta-oe \
    ${HOME}/poky-honister/meta-openembedded/meta-multimedia \
    ${HOME}/poky-honister/meta-openembedded/meta-networking \
    ${HOME}/poky-honister/meta-openembedded/meta-perl \
    ${HOME}/poky-honister/meta-openembedded/meta-python \
    ${HOME}/poky-honister/meta-raspberrypi \
    ${HOME}/poky-honister/meta-security \
    ${HOME}/rpi64/meta-rpi64 \
"
```

## conf/layer.conf
```bitbake
# We have a conf and classes directory, append to BBPATH
BBPATH .= ":${LAYERDIR}"

# We have a recipes directory, add to BBFILES
BBFILES += "${LAYERDIR}/recipes*/*/*.bb ${LAYERDIR}/recipes*/*/*.bbappend ${LAYERDIR}/images/*.bb"

BBFILE_COLLECTIONS += "meta-rpi64"
BBFILE_PATTERN_meta-rpi64 := "^${LAYERDIR}/"
BBFILE_PRIORITY_meta-rpi64 = "16"

LAYERSERIES_COMPAT_meta-rpi64 = "mickledore"
```
