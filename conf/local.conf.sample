## conf/local.conf.sample
```bitbake
# Local configuration for meta-rpi64 images
# Yocto Project 5.2 Poky distribution [walnascar] branch

LICENSE_FLAGS_ACCEPTED = "commercial"

DISTRO_FEATURES = "ext2 opengl security systemd usbhost ${DISTRO_FEATURES_LIBC}"

DISTRO_FEATURES_BACKFILL_CONSIDERED += "sysvinit"

DISTRO_FEATURES:remove = "ptest"

INIT_MANAGER = "systemd"

MACHINE_FEATURES:remove = "apm vfat"

MACHINE_FEATURES += "vc4graphics"

IMAGE_FSTYPES = "tar.xz"

MACHINE = "raspberrypi4-64"

KERNEL_IMAGETYPE = "Image"

DISABLE_OVERSCAN = "1"
# ENABLE_UART = "1"
SERIAL_CONSOLES = "115200;ttyS0"

PREFERRED_VERSION_linux-raspberrypi = "6.12.%"

#DL_DIR = "/src/walnascar"
#SSTATE_DIR = "/oe1/rpi64/sstate-cache"
#TMPDIR = "/oe1/rpi64/tmp"

DISTRO = "poky"
PACKAGE_CLASSES = "package_ipk"

SDKMACHINE = "x86_64"

EXTRA_IMAGE_FEATURES = "empty-root-password allow-empty-password allow-root-login"

PATCHRESOLVE = "noop"
RM_OLD_IMAGE = "1"
INHERIT += "rm_work"
CONF_VERSION = "2"
```
